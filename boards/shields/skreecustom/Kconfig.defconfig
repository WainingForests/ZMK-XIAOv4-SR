## boards/shields/skreecustom/Kconfig.defconfig
```kconfig
if SHIELD_SKREECUSTOM_LEFT

config ZMK_KEYBOARD_NAME
    default "Skree Custom"

config ZMK_SPLIT_ROLE_CENTRAL
    default y

config PAW3395
    default y

config PAW3395_REPORT_INTERVAL_MIN
    default 8

endif

if SHIELD_SKREECUSTOM_LEFT || SHIELD_SKREECUSTOM_RIGHT

config ZMK_SPLIT
    default y

config ZMK_SLEEP
    default y

config ZMK_POINTING
    default y

config ZMK_POINTING_SMOOTH_SCROLLING
    default n

config SPI
    default y

config INPUT
    default y

config ZMK_RGB_UNDERGLOW_EXT_POWER
    default n

config ZMK_KSCAN_MATRIX_WAIT_BEFORE_INPUTS
    default 0

config ZMK_KSCAN_MATRIX_WAIT_BETWEEN_OUTPUTS
    default 1


endif

config ZMK_RGB_UNDERGLOW
    default y
    imply WS2812_STRIP
```

## config/west.yml
```yaml
manifest:
  remotes:
    - name: zmkfirmware
      url-base: https://github.com/zmkfirmware
    # Additional modules containing boards/shields/custom code can be listed here as well
    # See https://docs.zephyrproject.org/3.2.0/develop/west/manifest.html#projects
    - name: badjeff
      url-base: https://github.com/badjeff
  projects:
    - name: zmk
      remote: zmkfirmware
      revision: v0.3
      import: app/west.yml
    - name: zmk-paw3395-driver
      remote: badjeff
      revision: bffa61761dc1fb87d8bc04133c55a10bc899a359  # main as of 2026-06-18; lib built for Zephyr 3.5 (ZMK v0.3)
  self:
    path: config
```
